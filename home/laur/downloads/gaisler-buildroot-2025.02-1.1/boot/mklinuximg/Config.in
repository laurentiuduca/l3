## home/laur/downloads/gaisler-buildroot-2025.02-1.1/boot/mklinuximg/Config.in
```kconfig
config BR2_TARGET_MKLINUXIMG
	bool "mklinuximg"
	depends on (BR2_sparc_v8 || BR2_sparc_leon3 || BR2_sparc_leon5) && BR2_LINUX_KERNEL && BR2_LINUX_KERNEL_VMLINUX
	help
	  MKLINUXIMG is a second stage bootloader for Linux on LEON SPARC32
	  systems.

if BR2_TARGET_MKLINUXIMG
choice
	prompt "MKLINUXIMG Version"
	help
	  Select the specific MKLINUXIMG version you want to use

config BR2_TARGET_MKLINUXIMG_LATEST_VERSION
	bool "2.0.20"

config BR2_TARGET_MKLINUXIMG_CUSTOM_VERSION
	bool "Custom version"
	help
	  This option allows to use a specific official versions

config BR2_TARGET_MKLINUXIMG_CUSTOM_TARBALL
	bool "Custom tarball"

config BR2_TARGET_MKLINUXIMG_CUSTOM_GIT
	bool "Custom Git repository"

endchoice

config BR2_TARGET_MKLINUXIMG_CUSTOM_VERSION_VALUE
	string "MKLINUXIMG version"
	depends on BR2_TARGET_MKLINUXIMG_CUSTOM_VERSION

config BR2_TARGET_MKLINUXIMG_CUSTOM_TARBALL_LOCATION
	string "URL of custom MKLINUXIMG tarball"
	depends on BR2_TARGET_MKLINUXIMG_CUSTOM_TARBALL

if BR2_TARGET_MKLINUXIMG_CUSTOM_GIT

config BR2_TARGET_MKLINUXIMG_CUSTOM_REPO_URL
	string "URL of custom repository"

config BR2_TARGET_MKLINUXIMG_CUSTOM_REPO_VERSION
	string "Custom repository version"
	help
	  Revision to use in the typical format used by Git,
	  e.g. a SHA ID, a tag, or branch.

endif

config BR2_TARGET_MKLINUXIMG_VERSION
	string
	default "2.0.20"	if BR2_TARGET_MKLINUXIMG_LATEST_VERSION
	default BR2_TARGET_MKLINUXIMG_CUSTOM_VERSION_VALUE \
		if BR2_TARGET_MKLINUXIMG_CUSTOM_VERSION
	default "custom"	if BR2_TARGET_MKLINUXIMG_CUSTOM_TARBALL
	default BR2_TARGET_MKLINUXIMG_CUSTOM_REPO_VERSION \
		if BR2_TARGET_MKLINUXIMG_CUSTOM_GIT

config BR2_TARGET_MKLINUXIMG_BASE
	hex "Linux Base Address"
	default 0x40000000
	help
	  Optional physical base address. The Linux kernel will be placed at
	  this address in main memory.
	  The default is 0x40000000.

config BR2_TARGET_MKLINUXIMG_CMDLINE
       string "Commandline to pass to the kernel"
       default "console=ttyS0,38400"

config BR2_TARGET_MKLINUXIMG_XML
       string "XML file with device tree additions"
       default ""

config BR2_TARGET_MKLINUXIMG_ARGS
       string "Additional arguments to pass to the mklinuximg call"
       default ""

endif
```
